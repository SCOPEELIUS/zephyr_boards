/*
* Copyright (c) 2017 Linaro Limited
*
* SPDX-License-Identifier: Apache-2.0
*/

/dts-v1/;
#include <st/f1/stm32f103Xe.dtsi>
#include <st/f1/stm32f103r(c-d-e)tx-pinctrl.dtsi>
#include <zephyr/dt-bindings/input/input-event-codes.h>

/ {
	model = "STMicroelectronics STM32F103RET6 board";
	compatible = "st,stm32f103ret6";
	
	chosen {
		zephyr,console = &usart2;
		zephyr,shell-uart = &usart2;
		zephyr,sram = &sram0;
		zephyr,flash = &flash0;
	};
	
	leds: leds {
		compatible = "gpio-leds";
		
		green_led_2: led_2 {
			gpios = <&gpioc 4 GPIO_ACTIVE_HIGH>;
			label = "User LD2";
		};
	};
	
	aliases {
		led0 = &green_led_2;
		watchdog0 = &iwdg;
	};
};

&gpioa {
	status = "okay";
};

&gpiob {
	status = "okay";
};

&gpioc {
	status = "okay";
};

&clk_lsi {
	status = "okay";
};

&clk_hsi {
	clock-frequency = <DT_FREQ_M(8)>; /* 8MHz clock */
	status = "okay";
};

&pll {
	mul = <9>;
	clocks = <&clk_hse>;
	status = "disabled";
};

&rcc {
	clocks = <&clk_hsi>;
	clock-frequency = <DT_FREQ_M(8)>;
	ahb-prescaler = <1>;
	apb1-prescaler = <2>;
	apb2-prescaler = <1>;
};

&usart1 {
	pinctrl-0 = <&usart1_tx_pa9 &usart1_rx_pa10>;
	pinctrl-names = "default";
	current-speed = <115200>;
	status = "okay";
};

&usart2 {
	pinctrl-0 = <&usart2_tx_pa2 &usart2_rx_pa3>;
	pinctrl-names = "default";
	current-speed = <115200>;
	status = "okay";
};

&iwdg {
	status = "okay";
};


&dma1 {
	status = "okay";
};

&sram0: memory@20000000 {
	reg = <0x20000000 DT_SIZE_K(64)>;
};
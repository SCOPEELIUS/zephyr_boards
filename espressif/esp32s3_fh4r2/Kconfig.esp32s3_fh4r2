## espressif/esp32s3_fh4r2/Kconfig.esp32s3_fh4r2
```kconfig
# Copyright (c) 2025 Elius Faustine.
# SPDX-License-Identifier: Apache-2.0

config BOARD_ESP32S3_FH4R2
	select SOC_ESP32S3_MINI_N4R2
	select SOC_ESP32S3_PROCPU if BOARD_ESP32S3_FH4R2_ESP32S3_PROCPU
	select SOC_ESP32S3_APPCPU if BOARD_ESP32S3_FH4R2_ESP32S3_APPCPU
```

## espressif/esp32s3_fh4r2/board.yml
```yaml
board:
  name: esp32s3_fh4r2
  full_name: ESP32-S3-FH4R2
  vendor: espressif
  socs:
  - name: esp32s3
```

## espressif/esp32s3_mini_n8/Kconfig.esp32s3_mini_n8
```kconfig
# Copyright (c) 2025 Elius Faustine.
# SPDX-License-Identifier: Apache-2.0

config BOARD_ESP32S3_MINI_N8
	select SOC_ESP32S3_MINI_N8
	select SOC_ESP32S3_PROCPU if BOARD_ESP32S3_MINI_N8_ESP32S3_PROCPU
	select SOC_ESP32S3_APPCPU if BOARD_ESP32S3_MINI_N8_ESP32S3_APPCPU
```

## espressif/esp32s3_mini_n8/board.yml
```yaml
board:
  name: esp32s3_mini_n8
  full_name: ESP32-S3-MINI-N8
  vendor: espressif
  socs:
  - name: esp32s3
```

## st/stm32f103ret6/Kconfig.stm32f103ret6
```kconfig
# Copyright (c) 2026 (ELIUS FAUSTINE <scopeelius@gmail.com>)
# SPDX-License-Identifier: Apache-2.0

config BOARD_STM32F103RET6
	select SOC_STM32F103XE
```

## st/stm32f103ret6/board.yml
```yaml
board:
  name: stm32f103ret6
  full_name: STM32F103RET6
  vendor: st
  socs:
    - name: stm32f103xe
```

## st/stm32l051c8t6/Kconfig.stm32l051c8t6
```kconfig
# Copyright (c) 2026 Elius Faustine <elius@vortan.io>
# SPDX-License-Identifier: Apache-2.0

config BOARD_STM32L051C8T6
	select SOC_STM32L051XX
```

## st/stm32l051c8t6/board.yml
```yaml
board:
  name: stm32l051c8t6
  full_name: STM32L051C8T6
  vendor: st
  socs:
    - name: stm32l051xx
```
